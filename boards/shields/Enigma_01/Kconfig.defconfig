## boards/shields/Enigma_01/Kconfig.defconfig
```kconfig
if SHIELD_Enigma_01

# Basic
config ZMK_KEYBOARD_NAME
    default "Enigma_01"

config ZMK_USB
	default y

config ZMK_BLE
	default y

config ZMK_MOUSE
	default y

endif
```

## boards/shields/Enigma_01/Kconfig.shield
```kconfig
config SHIELD_Enigma_01_a
    def_bool $(shields_list_contains,Enigma_01_a)

config SHIELD_Enigma_01_b
    def_bool $(shields_list_contains,Enigma_01_b)

config SHIELD_Enigma_01_c
    def_bool $(shields_list_contains,Enigma_01_c)
```

## config/west.yml
```yaml
manifest:
  remotes:
    - name: zmkfirmware
      url-base: https://github.com/zmkfirmware
    - name: kot149
      url-base: https://github.com/kot149
    - name: caksoylar
      url-base: https://github.com/caksoylar
    - name: ssbb
      url-base: https://github.com/ssbb
  projects:
    - name: zmk
      remote: zmkfirmware
      revision: v0.2.1
      import: app/west.yml
    - name: zmk-layout-shift
      remote: kot149
      revision: v1
    - name: zmk-rgbled-widget
      remote: caksoylar
      revision: main
    - name: zmk-listeners
      remote: ssbb
      revision: v1
  self:
    path: config
```
